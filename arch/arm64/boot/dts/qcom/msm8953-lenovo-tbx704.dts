/*
 * Lenovo TAB4 10 Plus (TB-X704F/L)
 *
 * This program is free software; you can redistribute it and/or modify
 * it under the terms of the GNU General Public License version 2 and
 * only version 2 as published by the Free Software Foundation.
 */

/dts-v1/;

#include "msm8953.dtsi"
#include "pmi8950.dtsi"
#include "msm8953-qrd-sku3.dtsi"
#include "msm8953-pmi8950.dtsi"
#include "lenovo/tbx704.dtsi"
